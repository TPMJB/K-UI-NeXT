/* SPDX-License-Identifier: GPL-3.0-only */
/* Reviewed SDK SCI family fingerprints and decoders, shared verbatim by the
 * live route admission and the image-only family finder. The including file
 * defines u32() and fingerprint() first. */
/* This family retains every instruction byte. Only the named, independently
 * decoded literal words below are normalized; a RAM-looking value is never
 * a wildcard. The two original owner profiles above remain unchanged. */
static const uint8_t family_vector_prefix[32]={
    0x48,0x3c,0x13,0x82,0x8a,0x7a,0xc7,0x11,0xda,0xf2,0xd9,0x70,0xfc,0x60,0x92,0xda,
    0x1c,0x35,0x82,0x65,0x36,0x14,0x43,0x07,0x23,0xef,0x83,0xe6,0xa0,0x2c,0xd6,0x96};
static const uint8_t family_vector[32]={
    0x4a,0x53,0xc6,0x6e,0xec,0xb7,0xd2,0x67,0xf4,0x06,0x12,0xc8,0xa8,0x17,0x02,0x09,
    0x5a,0x81,0x6f,0x10,0x3a,0x4d,0x9c,0xc6,0xd8,0x0d,0x44,0xc6,0x62,0x99,0x8d,0x07};
static const uint8_t family_normal[32]={
    0x56,0xed,0x5e,0x08,0xb6,0x69,0x3a,0x31,0xcb,0xf2,0xbe,0xd9,0x5f,0xd3,0x17,0x0f,
    0xa2,0xd4,0x1c,0x62,0xc3,0xc0,0x99,0x77,0x40,0xac,0x06,0xb8,0x7c,0xfd,0x96,0x44};
static const uint8_t family_fpu[32]={
    0xf2,0x4c,0x04,0x41,0xd0,0x47,0x1c,0x71,0x16,0xa1,0x51,0xc3,0x2d,0xf2,0x00,0x33,
    0x4e,0x95,0x2a,0x83,0x14,0x25,0xea,0xa7,0x44,0x2a,0xf0,0x77,0x61,0xbb,0x25,0x0e};
static const uint8_t family_default[32]={
    0xb5,0xa4,0x25,0xf0,0x64,0x9a,0x8f,0x1b,0x5b,0x27,0x03,0xb4,0xb4,0xd1,0x68,0xe4,
    0xcd,0x02,0x51,0x78,0x9e,0xd5,0x6a,0xf1,0x85,0xde,0x84,0x2a,0xd2,0x7e,0x13,0xff};
/* A separately reviewed compact FPU save/restore family. No instruction is
 * normalized, and common/default windows from the two families cannot mix. */
static const uint8_t compact_normal[32]={
    0x3f,0xba,0x9f,0x81,0x66,0x0b,0x83,0xaa,0xa4,0x09,0xd5,0x20,0xbf,0x3d,0xcd,0xd5,
    0xe2,0xe5,0x68,0xcf,0x4d,0x4a,0xbf,0x11,0x6c,0xf3,0x28,0xe2,0xe3,0x17,0xf3,0xad};
static const uint8_t compact_fpu[32]={
    0xc7,0xf3,0xaa,0x88,0xc0,0x3c,0x99,0x1f,0x20,0x07,0x8b,0x1e,0xdd,0xdb,0x67,0x14,
    0x1f,0x69,0x57,0x71,0x9c,0x6b,0x3e,0x8f,0x22,0x73,0xdd,0x24,0x6e,0xb4,0x92,0x51};
static const uint8_t compact_default[32]={
    0xd4,0xbb,0x5d,0x00,0xfb,0x05,0xa1,0x1d,0x21,0x44,0x3c,0x92,0xf8,0xfe,0x79,0x18,
    0xda,0x0d,0x92,0x9e,0xdb,0xd1,0xfb,0xb7,0x1d,0x6d,0xae,0x26,0x76,0x18,0x52,0xfb};
/* The round-toward-zero (Shinobi "zr") build of the full family: each of the
 * four FPSCR set-ups inserts one ADD #1,R0, so the common handlers grow by four
 * bytes each and the event word moves to +0x3a0. Every other instruction,
 * branch, literal role, default, initializer and helper is the full family's. */
static const uint8_t zero_normal[32]={
    0x5c,0xc1,0x4c,0xfc,0xa0,0x83,0x95,0x67,0x74,0x91,0xb8,0xc1,0x05,0x28,0x33,0x82,
    0x0d,0x25,0x7f,0x60,0xa1,0x68,0xca,0x24,0xe1,0x9f,0xa0,0x2f,0x69,0xec,0xf0,0x37};
static const uint8_t zero_fpu[32]={
    0x1a,0xfe,0xb9,0xb8,0x50,0x47,0x04,0xb3,0x9c,0x10,0x4e,0x72,0x05,0x50,0x8d,0x99,
    0x36,0x0e,0x44,0x28,0x11,0xac,0xc8,0x26,0xc1,0xf2,0x71,0xf7,0x1a,0xa6,0x52,0x4b};
static const uint8_t family_init[32]={
    0x6c,0x5b,0x89,0x76,0x4f,0xba,0x51,0xb3,0x7c,0x25,0xa3,0xbf,0xa6,0x6c,0x83,0xe6,
    0x01,0x16,0xfa,0x56,0xe0,0xc1,0x77,0xa2,0x00,0x9c,0xc0,0x67,0xf5,0xa4,0x9f,0x87};
/* The original default's helper takes its direct return for SCI ERI/RXI.
 * These three exact windows prove that path without admitting or changing
 * its unrelated debug-print paths and their game-owned data pointers. */
static const struct {uint32_t offset,bytes;uint8_t sha256[32];} helper_windows[]={
    {0u,0x34u,{
        0x56,0xfb,0x7a,0xca,0x2a,0xf8,0x23,0xe8,0x55,0x02,0xad,0x44,0x4f,0xd1,0xdf,0x41,
        0x30,0xa9,0x3b,0x58,0x53,0x60,0x37,0xfd,0x85,0x66,0x05,0xb7,0xb3,0x5c,0x14,0x23}},
    {0x120u,12u,{
        0x52,0x42,0x35,0xe1,0xc9,0x36,0x93,0x7f,0x19,0x9f,0xda,0x43,0x16,0x66,0x1a,0x5e,
        0x48,0xc5,0x11,0x16,0x26,0x1c,0x20,0x5c,0xd9,0xec,0xa3,0xb4,0x71,0xfe,0xee,0x78}},
    {0x224u,0x14u,{
        0xfe,0x0a,0x08,0xca,0x04,0xe7,0x9c,0x38,0xdc,0x46,0x9e,0x82,0x21,0xaa,0x20,0xf3,
        0x99,0x1d,0xbd,0xb4,0x9d,0x8f,0x3d,0xf7,0xb7,0x8b,0x11,0x53,0x92,0xc0,0x59,0x40}},
};
static uint16_t u16(const uint8_t *p) {return (uint16_t)p[0]|(uint16_t)p[1]<<8;}
static bool normalized(const uint8_t *p,size_t n,const uint16_t *holes,
    size_t count,const uint8_t expected[32]) {
    static const uint8_t zero[4]={0};
    struct kui_sha256 hash;uint8_t digest[32];size_t at=0u;
    kui_sha256_init(&hash);
    for(size_t i=0u;i<count;i++) {
        size_t hole=holes[i];
        if(hole<at || hole>n || n-hole<4u)return false;
        kui_sha256_update(&hash,p+at,hole-at);kui_sha256_update(&hash,zero,4u);at=hole+4u;
    }
    kui_sha256_update(&hash,p+at,n-at);kui_sha256_digest(&hash,digest);
    return !memcmp(digest,expected,sizeof(digest));
}
static bool image_span(uint32_t address,size_t bytes,uint32_t load,size_t n,size_t *at) {
    if(address<load || address-load>n || bytes>n-(address-load))return false;
    *at=address-load;return true;
}
static bool owner_span(uint32_t address,size_t bytes,uint32_t area,
    uint32_t load,size_t n,size_t *at) {
    return (address&UINT32_C(0xe0000000))==area &&
        image_span((address&UINT32_C(0x1fffffff))|UINT32_C(0x80000000),bytes,load,n,at);
}
/* MOV.L @(disp,PC),Rn, including SH's aligned PC+4 base. The full code
 * fingerprint also pins every use, branch and delay-slot instruction. */
static bool literal_at(const uint8_t *p,uint32_t address,size_t instruction,
    unsigned reg,size_t wanted) {
    uint16_t op=u16(p+instruction);
    return (op&0xff00u)==(uint16_t)(0xd000u|(reg<<8)) &&
        (((address+(uint32_t)instruction+4u)&~3u)+4u*(op&255u))==address+wanted;
}
/* The early Shinobi (1.41-1.43) interrupt family. Two 0x34-byte stubs, the
 * EXPEVT one copied to VBR+0x100/+0x400 and the INTEVT one to VBR+0x600,
 * record their event code in one word and jump to a single common handler.
 * That handler saves the FPU and dispatches through the full family's table
 * (VBR+0x200+(code-0x200)/8), filled by the same reviewed initializer. The
 * default has no debug helper: it unwinds the common frame and enters the
 * same system return path the full family's default takes after its helper.
 * FPSCR is round-toward-zero throughout. Every instruction is fingerprinted;
 * only the event, R0 scratch, common and event-relative literals are holes. */
static const uint8_t early_expevt[32]={
    0x1c,0x2c,0x17,0xac,0x31,0xcf,0xf3,0x95,0x91,0x8a,0x7e,0x21,0x6e,0x07,0xc0,0x53,
    0xb6,0x7b,0x15,0xf2,0x83,0xf1,0x80,0x15,0x6c,0x90,0x5f,0x28,0xe6,0x00,0xbd,0x22};
static const uint8_t early_intevt[32]={
    0xb5,0x19,0x32,0x94,0x3f,0xb6,0x9d,0xf8,0x2c,0x16,0x2d,0xec,0x6b,0x15,0x72,0xe9,
    0xef,0xf8,0x5e,0x21,0x86,0xb0,0xba,0x06,0x9e,0xe7,0xad,0x59,0x69,0xde,0xb1,0x9c};
static const uint8_t early_common[32]={
    0x8b,0xff,0xd9,0xdf,0x8f,0x7a,0x4b,0x54,0x44,0x08,0x89,0xdf,0x44,0xd5,0x96,0x72,
    0xbf,0xea,0x16,0x30,0xc6,0xfa,0xcb,0x4c,0xf1,0x65,0x47,0xca,0x89,0x57,0xf4,0xbd};
static const uint8_t early_default[32]={
    0x1f,0xdf,0x9e,0xd9,0x98,0x1b,0xc3,0xcb,0xcd,0x9e,0x6f,0x7e,0xba,0x89,0x36,0x00,
    0x4e,0x85,0x4d,0xb0,0xb0,0xe6,0x86,0xf5,0xaa,0x01,0x98,0x21,0x65,0x78,0xca,0xec};
#define EARLY_STUB_BYTES 0x34u
#define EARLY_SCRATCH_WORD 11u
#define EARLY_COMMON_BYTES 0x14cu
#define EARLY_EVENT_OFFSET 0x2d4u
#define EARLY_DEFAULT_BYTES 0xc4u
struct early_family {size_t stub_at,default_at;uint32_t stub,common,original,event;};
/* Image-only roles of the early family: 1 found, 0 none, -1 malformed or
 * ambiguous. Callers try it only when no full/compact vector prefix exists. */
static int early_family(const uint8_t *p,size_t n,uint32_t load,struct early_family *out) {
    static const uint16_t early_stub_holes[]={0x28u,0x2cu,0x30u};
    static const uint16_t early_common_hole[]={0x148u};
    static const uint16_t early_default_holes[]={0xb8u,0xbcu,0xc0u};
    static const uint16_t early_init_holes[]={0x2au};
    size_t stub_at=0u;unsigned stubs=0u;
    for(size_t at=EARLY_STUB_BYTES;at<n && n-at>=2u*EARLY_STUB_BYTES+EARLY_COMMON_BYTES;at+=4u) {
        if(u32(p+at)!=UINT32_C(0x00090009) || u16(p+at+0xau)!=0x2f16u ||
           !normalized(p+at,EARLY_STUB_BYTES,early_stub_holes,3u,early_intevt))continue;
        stub_at=at;if(++stubs>1u)return -1;
    }
    if(!stubs)return 0;
    size_t expevt_at=stub_at-EARLY_STUB_BYTES,common_at=stub_at+EARLY_STUB_BYTES;
    const uint8_t *s=p+stub_at,*x=p+expevt_at,*c=p+common_at;
    uint32_t event=u32(s+0x28u),area=event&UINT32_C(0xe0000000);
    uint32_t common=((load+(uint32_t)common_at)&UINT32_C(0x1fffffff))|area;
    uint32_t raw_event=((load+(uint32_t)common_at+EARLY_EVENT_OFFSET)&UINT32_C(0x1fffffff))|area;
    if((area!=0u && area!=UINT32_C(0x80000000)) || event!=raw_event ||
       n-common_at<EARLY_EVENT_OFFSET+4u ||
       !normalized(x,EARLY_STUB_BYTES,early_stub_holes,3u,early_expevt) ||
       u32(x+0x28u)!=event || u32(x+0x2cu) || u32(s+0x2cu) ||
       u32(x+0x30u)!=common || u32(s+0x30u)!=common ||
       !normalized(c,EARLY_COMMON_BYTES,early_common_hole,1u,early_common) || u32(c+0x148u)!=event)return -1;
    unsigned initializers=0u;bool bound=false;uint32_t original=0u;
    for(size_t at=0u;at<n && n-at>=0x2eu;at+=2u) {
        if(u16(p+at)!=0x9511u || u16(p+at+2u)!=0x9411u ||
           !normalized(p+at,0x2eu,early_init_holes,1u,family_init))continue;
        if(++initializers>1u)return -1;
        bound=literal_at(p+at,load+(uint32_t)at,4u,7u,0x2au);
        original=u32(p+at+0x2au);
    }
    size_t default_at;
    if(initializers!=1u || !bound || (original&3u) ||
       !owner_span(original,EARLY_DEFAULT_BYTES,area,load,n,&default_at))return -1;
    const uint8_t *d=p+default_at;
    if(!normalized(d,EARLY_DEFAULT_BYTES,early_default_holes,3u,early_default) ||
       u32(d+0xb8u)!=event+4u || u32(d+0xbcu)!=event-8u || u32(d+0xc0u)!=event-4u)return -1;
    *out=(struct early_family){stub_at,default_at,load+(uint32_t)stub_at,common,original,event};
    return 1;
}
